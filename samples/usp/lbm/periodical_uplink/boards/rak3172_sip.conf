## west.yml
```yaml
manifest:
  projects:
  - import: true
    name: zephyr
    revision: v4.3.0
    url: https://github.com/zephyrproject-rtos/zephyr
  - name: usp
    path: modules/lib/usp
    revision: v1.1.1-feature-202602
    submodules: true
    url: https://github.com/Lora-net/usp.git
  self:
    path: application
```
